/**
 * MAX7219 LED Matrix Driver Implementation
 *
 * Driver for 4x 8x8 LED Dot Matrix Display
 * Cascaded MAX7219 configuration with 5x7 font rendering
 */

#include "max7219_driver.h"

// 5x7 Font - Each character is 5 columns wide
// Data is rotated: each byte represents one column, LSB = top row
static const uint8_t FONT_5X7[][5] PROGMEM = {
    {0x00, 0x00, 0x00, 0x00, 0x00}, // Space (32)
    {0x00, 0x00, 0x5F, 0x00, 0x00}, // !
    {0x00, 0x07, 0x00, 0x07, 0x00}, // "
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    {0x08, 0x1C, 0x2A, 0x08, 0x08}, // <- (127)
};

// Character width (all 5 for this font, but kept for future variable-width)
#define CHAR_WIDTH 5
#define CHAR_SPACING 1

MAX7219Driver::MAX7219Driver()
    : _brightness(128), _cursorCol(0), _initialized(false), _rotated(false) {
    memset(_framebuffer, 0, sizeof(_framebuffer));
}

void MAX7219Driver::begin() {
    // Configure pins
    pinMode(MAX7219_PIN_CS, OUTPUT);
    digitalWrite(MAX7219_PIN_CS, HIGH);
    
    // Initialize SPI
    SPI.begin();
    
    delay(50);  // Wait for MAX7219 to stabilize
    
    // Initialize all modules
    sendToAll(MAX7219_REG_DISPLAYTEST, 0x00);  // Normal operation
    sendToAll(MAX7219_REG_SCANLIMIT, 0x07);    // Display all 8 digits/rows
    sendToAll(MAX7219_REG_DECODE, 0x00);       // No BCD decode
    sendToAll(MAX7219_REG_SHUTDOWN, 0x01);     // Normal operation (not shutdown)
    
    setBrightness(_brightness);
    clear();
    
    _initialized = true;
    Serial.println("MAX7219 Driver initialized");
}

void MAX7219Driver::clear() {
    memset(_framebuffer, 0, sizeof(_framebuffer));
    refresh();
    _cursorCol = 0;
}

void MAX7219Driver::setBrightness(uint8_t brightness) {
    _brightness = brightness;
    // Map 0-255 to 0-15 for MAX7219
    uint8_t intensity = map(brightness, 0, 255, 0, 15);
    sendToAll(MAX7219_REG_INTENSITY, intensity);
}

uint8_t MAX7219Driver::getBrightness() const {
    return _brightness;
}

void MAX7219Driver::setCursor(uint8_t position) {
    if (position >= MAX7219_TOTAL_COLS) {
        position = 0;
    }
    _cursorCol = position;
}

void MAX7219Driver::print(const char* text) {
    clear();
    _cursorCol = 0;
    
    while (*text && _cursorCol < MAX7219_TOTAL_COLS) {
        printChar(*text);
        text++;
    }
    
    refresh();
}

void MAX7219Driver::printChar(char c) {
    uint8_t width;
    const uint8_t* glyph = getGlyph(c, width);
    
    // Copy glyph columns to framebuffer
    for (uint8_t i = 0; i < width && _cursorCol < MAX7219_TOTAL_COLS; i++) {
        _framebuffer[_cursorCol++] = pgm_read_byte(&glyph[i]);
    }
    
    // Add spacing between characters
    if (_cursorCol < MAX7219_TOTAL_COLS) {
        _framebuffer[_cursorCol++] = 0x00;
    }
}

void MAX7219Driver::setColumn(uint8_t col, uint8_t data) {
    if (col < MAX7219_TOTAL_COLS) {
        _framebuffer[col] = data;
    }
}

void MAX7219Driver::refresh() {
    // Send framebuffer to display
    // MAX7219 is organized by rows, but our framebuffer is by columns
    // Need to transpose and send row by row
    
    for (uint8_t row = 0; row < 8; row++) {
        SPI.beginTransaction(SPISettings(10000000, MSBFIRST, SPI_MODE0));
        digitalWrite(MAX7219_PIN_CS, LOW);
        
        // When rotated 180 degrees, we invert row index and reverse bit order
        uint8_t displayRow = _rotated ? (7 - row) : row;
        
        // Send data to each module in chain (last module first in data stream)
        for (int8_t module = MAX7219_NUM_MODULES - 1; module >= 0; module--) {
            uint8_t rowData = 0;
            
            // When rotated, reverse the module order
            int8_t srcModule = _rotated ? (MAX7219_NUM_MODULES - 1 - module) : module;
            
            // Build row data from framebuffer columns
            // Each module handles 8 columns
            for (uint8_t col = 0; col < 8; col++) {
                // When rotated, reverse column order within module
                uint8_t srcCol = _rotated ? (7 - col) : col;
                uint8_t fbCol = srcModule * 8 + srcCol;
                
                if (_framebuffer[fbCol] & (1 << displayRow)) {
                    rowData |= (1 << (7 - col));  // Reverse bit order for display
                }
            }
            
            SPI.transfer(MAX7219_REG_DIGIT0 + row);  // Row register
            SPI.transfer(rowData);
        }
        
        digitalWrite(MAX7219_PIN_CS, HIGH);
        SPI.endTransaction();
    }
}

void MAX7219Driver::setRotation(bool flipped) {
    _rotated = flipped;
    refresh();  // Update display with new rotation
}

void MAX7219Driver::sendToAll(uint8_t reg, uint8_t data) {
    SPI.beginTransaction(SPISettings(10000000, MSBFIRST, SPI_MODE0));
    digitalWrite(MAX7219_PIN_CS, LOW);
    
    for (uint8_t i = 0; i < MAX7219_NUM_MODULES; i++) {
        SPI.transfer(reg);
        SPI.transfer(data);
    }
    
    digitalWrite(MAX7219_PIN_CS, HIGH);
    SPI.endTransaction();
}

void MAX7219Driver::sendToModule(uint8_t module, uint8_t reg, uint8_t data) {
    SPI.beginTransaction(SPISettings(10000000, MSBFIRST, SPI_MODE0));
    digitalWrite(MAX7219_PIN_CS, LOW);
    
    for (uint8_t i = 0; i < MAX7219_NUM_MODULES; i++) {
        if (i == module) {
            SPI.transfer(reg);
            SPI.transfer(data);
        } else {
            SPI.transfer(MAX7219_REG_NOOP);
            SPI.transfer(0);
        }
    }
    
    digitalWrite(MAX7219_PIN_CS, HIGH);
    SPI.endTransaction();
}

const uint8_t* MAX7219Driver::getGlyph(char c, uint8_t& width) {
    width = CHAR_WIDTH;
    
    // Map character to font index
    if (c >= 32 && c <= 127) {
        return FONT_5X7[c - 32];
    }
    
    // Return space for unknown characters
    return FONT_5X7[0];
}
